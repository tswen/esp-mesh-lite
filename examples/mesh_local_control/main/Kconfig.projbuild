## examples/mesh_local_control/main/Kconfig.projbuild
```kconfig
menu "Example Configuration"

config ROUTER_SSID
    string "Router SSID"
        default "ROUTER_SSID"
        help
            Router SSID.

config ROUTER_PASSWORD
    string "Router password"
        default "ROUTER_PASSWORD"
        help
            Router password.

config SERVER_IP
    string "Server IP address"
        default "192.168.0.1"
        help
            Server IP address.

config SERVER_PORT
    int "Server port"
        default "8070"
        help
            Server port.

config EXAMPLE_LED_RED_SYSTEM_GPIO
    int "System status led (red) gpio, set 0 if not use"
    default 15
config EXAMPLE_LED_BLUE_WIFI_GPIO
    int "Wi-Fi status led (blue) gpio, set 0 if not use"
    default 17
config EXAMPLE_LED_GREEN_4GMODEM_GPIO
    int "Modem status led (green) gpio, set 0 if not use"
    default 16

endmenu
```
