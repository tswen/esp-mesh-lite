## examples/mesh_wifi_provisioning/sdkconfig.defaults
```kconfig
# Override some defaults in mesh application project.

# Partition Table
CONFIG_PARTITION_TABLE_SINGLE_APP_LARGE=y # You can choose another partition table, this is not mandatory

# FreeRTOS
CONFIG_FREERTOS_TIMER_TASK_STACK_DEPTH=3072

# LWIP
CONFIG_LWIP_IP_FORWARD=y
CONFIG_LWIP_IPV4_NAPT=y

# ESP System Settings
CONFIG_ESP_SYSTEM_EVENT_TASK_STACK_SIZE=4096

# ESP Wi-Fi Mesh Lite
CONFIG_MESH_LITE_ENABLE=y
CONFIG_MESH_LITE_PROV_ENABLE=y
CONFIG_JOIN_MESH_WITHOUT_CONFIGURED_WIFI_INFO=n

# BT
CONFIG_BT_NIMBLE_ENABLED=y

# Bridge Configuration
CONFIG_BRIDGE_SOFTAP_SSID_END_WITH_THE_MAC=y # To distinguish the softap of different Mesh devices, it is recommended to enable this option, but it is not mandatory
```

## examples/no_router/sdkconfig.defaults
```kconfig
# Override some defaults in mesh application project.

# FreeRTOS
CONFIG_FREERTOS_TIMER_TASK_STACK_DEPTH=3072

# LWIP
CONFIG_LWIP_IP_FORWARD=y
CONFIG_LWIP_IPV4_NAPT=y

# ESP System Settings
CONFIG_ESP_SYSTEM_EVENT_TASK_STACK_SIZE=4096

# ESP Wi-Fi Mesh Lite
CONFIG_MESH_LITE_ENABLE=y

# Bridge Configuration
CONFIG_BRIDGE_SOFTAP_SSID_END_WITH_THE_MAC=y # To distinguish the softap of different Mesh devices, it is recommended to enable this option, but it is not mandatory
```
